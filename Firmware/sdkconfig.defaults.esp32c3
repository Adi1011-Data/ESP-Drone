## Firmware/sdkconfig.defaults.esp32c3
```kconfig
CONFIG_IDF_TARGET="esp32c3"

CONFIG_FREERTOS_UNICORE=y

CONFIG_ESP_DEFAULT_CPU_FREQ_MHZ_160=y
CONFIG_ESP_DEFAULT_CPU_FREQ_MHZ=160

CONFIG_ESPTOOLPY_FLASHMODE_DIO=y
CONFIG_ESPTOOLPY_FLASHMODE="dio"
CONFIG_ESPTOOLPY_FLASHFREQ_80M=y
CONFIG_ESPTOOLPY_FLASHSIZE_4MB=y
CONFIG_ESPTOOLPY_FLASHSIZE="4MB"

CONFIG_ESP_CONSOLE_USB_SERIAL_JTAG=y

CONFIG_TARGET_ESP32_C3_XIAO=y
CONFIG_BASE_STACK_SIZE=512

# ESP-Drone app 0.7.3 uses CRTP. The older 11-byte ESPlane packet stays off.
# CONFIG_ENABLE_LEGACY_APP is not set
CONFIG_ENABLE_POSITION_HOLD_MODE=y
CONFIG_ENABLE_COMMAND_MODE_SET=y

# CONFIG_BUZZER_ON is not set
CONFIG_MOTOR_BRUSHED_720=y

CONFIG_I2C0_PIN_SDA=6
CONFIG_I2C0_PIN_SCL=7
CONFIG_MPU_PIN_INT=20
CONFIG_ADC1_PIN=4

CONFIG_MOTOR01_PIN=2
CONFIG_MOTOR02_PIN=10
CONFIG_MOTOR03_PIN=3
CONFIG_MOTOR04_PIN=5

CONFIG_LED_PIN_BLUE=3
CONFIG_LED_PIN_GREEN=3
CONFIG_LED_PIN_RED=3

CONFIG_PITCH_CALIB=0
CONFIG_ROLL_CALIB=0

CONFIG_BTDM_CTRL_MODE_BLE_ONLY=y
# CONFIG_BTDM_CTRL_MODE_BR_EDR_ONLY is not set
# CONFIG_BTDM_CTRL_MODE_BTDM is not set
# CONFIG_BT_BLUEDROID_ENABLED is not set
CONFIG_BT_NIMBLE_ENABLED=y

CONFIG_PARTITION_TABLE_SINGLE_APP_LARGE=y
```
